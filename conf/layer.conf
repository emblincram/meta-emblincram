## conf/layer.conf
```bitbake
# We have a conf and classes directory, add to BBPATH
BBPATH .= ":${LAYERDIR}"

# We have recipes-* directories, add to BBFILES
BBFILES += "${LAYERDIR}/recipes-*/*/*.bb \
            ${LAYERDIR}/recipes-*/*/*.bbappend"

BBFILE_COLLECTIONS += "emblincram"
BBFILE_PATTERN_emblincram = "^${LAYERDIR}/"
BBFILE_PRIORITY_emblincram = "6"

# bitbake -e | grep "^DISTRO_CODENAME="
LAYERDEPENDS_emblincram = "core"
LAYERSERIES_COMPAT_emblincram = "scarthgap"
```

## meta-base/conf/bblayers.conf.sample
```bitbake
# POKY_BBLAYERS_CONF_VERSION is increased each time build/conf/bblayers.conf
# changes incompatibly

POKY_BBLAYERS_CONF_VERSION = "2"

BBPATH = "${TOPDIR}"
BBFILES ?= ""

BBLAYERS ?= " \
  ##OEROOT##/meta \
  ##OEROOT##/meta-poky \
  ##OEROOT##/meta-yocto-bsp \
  "

BBLAYERS += " \
  /mnt/ssd/yocto/beaglebone/meta-arm/meta-arm \
  /mnt/ssd/yocto/beaglebone/meta-arm/meta-arm-toolchain \
  /mnt/ssd/yocto/beaglebone/meta-ti/meta-ti-bsp \
  /mnt/ssd/yocto/beaglebone/meta-ti/meta-ti-extras \
  /mnt/ssd/yocto/beaglebone/meta-openembedded/meta-oe \
  /mnt/ssd/yocto/beaglebone/meta-openembedded/meta-python \
  /mnt/ssd/yocto/beaglebone/meta-openembedded/meta-networking \
  /mnt/ssd/yocto/beaglebone/meta-openembedded/meta-webserver \
  "

BBLAYERS += " \
  /mnt/ssd/yocto/beaglebone/meta-romsila \
  "

BBLAYERS += " \
  /mnt/ssd/yocto/beaglebone/meta-helloly \
  "

BBLAYERS += " \
  /mnt/ssd/yocto/beaglebone/meta-distrap \
  "

BBLAYERS += " \
  /mnt/ssd/yocto/beaglebone/meta-heartbeat \
  "

BBLAYERS += " \
  /mnt/ssd/yocto/beaglebone/meta-mylayer \
  "

BBLAYERS += " \
  /mnt/ssd/yocto/beaglebone/meta-streamer \
  "
```

## meta-base/conf/layer.conf
```bitbake
# We have a conf and classes directory, add to BBPATH
BBPATH .= ":${LAYERDIR}"

# We have recipes-* directories, add to BBFILES
BBFILES += "${LAYERDIR}/recipes-*/*/*.bb \
            ${LAYERDIR}/recipes-*/*/*.bbappend"

BBFILE_COLLECTIONS += "base"
BBFILE_PATTERN_base = "^${LAYERDIR}/"
BBFILE_PRIORITY_base = "6"

# bitbake -e | grep "^DISTRO_CODENAME="
LAYERDEPENDS_base = "core"
LAYERSERIES_COMPAT_base = "kirkstone mickledore nanbield"
```

## meta-base/wic/beaglebone-emmc.wks
```
# BeagleBone Black eMMC-Layout
# GPT-Partitionierung, Bootloader, Boot- und Root-Partition

# Bootloader (U-Boot) installieren
bootloader --ptable gpt --source bootloader

# Boot-Partition (VFat)
part /boot --source bootimg-partition --ondisk mmcblk1 --fstype=vfat --label boot --active --align 4 --size=64M

# Root-Partition (EXT4)
part / --source rootfs --ondisk mmcblk1 --fstype=ext4 --label root --align 4 --size=2000M

# U-Boot-Environment (optional)
#part /uboot-env --source rawcopy --ondisk mmcblk1 --align 4 --size=8M
```

## meta-hello/conf/layer.conf
```bitbake
# We have a conf and classes directory, add to BBPATH
BBPATH .= ":${LAYERDIR}"

# We have recipes-* directories, add to BBFILES
BBFILES += "${LAYERDIR}/recipes-*/*/*.bb \
            ${LAYERDIR}/recipes-*/*/*.bbappend"

BBFILE_COLLECTIONS += "hello"
BBFILE_PATTERN_hello = "^${LAYERDIR}/"
BBFILE_PRIORITY_hello = "6"

# bitbake -e | grep "^DISTRO_CODENAME="
LAYERDEPENDS_hello = "core"
LAYERSERIES_COMPAT_hello = "scarthgap"
```

## meta-helloly/conf/layer.conf
```bitbake
# SPDX-License-Identifier: MIT
# SPDX-Author: Roman Koch <koch.romam@gmail.com>
# SPDX-Copyright: 2024 Roman Koch <koch.romam@gmail.com>

# We have a conf and classes directory, add to BBPATH
BBPATH .= ":${LAYERDIR}"

# We have recipes-* directories, add to BBFILES
BBFILES += "${LAYERDIR}/recipes-*/*/*.bb \
            ${LAYERDIR}/recipes-*/*/*.bbappend"

BBFILE_COLLECTIONS += "helloly"
BBFILE_PATTERN_helloly = "^${LAYERDIR}/"
BBFILE_PRIORITY_helloly = "6"

# bitbake -e | grep "^DISTRO_CODENAME="
LAYERDEPENDS_helloly = "core"
LAYERSERIES_COMPAT_helloly = "scarthgap"
```

## meta-mylayer/conf/layer.conf
```bitbake
# SPDX-License-Identifier: MIT
# SPDX-Author: Roman Koch <koch.romam@gmail.com>
# SPDX-Copyright: 2024 Roman Koch <koch.romam@gmail.com>

BBPATH .= ":${LAYERDIR}"
BBFILES += "${LAYERDIR}/recipes-*/*/*.bb \
            ${LAYERDIR}/recipes-*/*/*.bbappend"

BBFILE_COLLECTIONS += "mylayer"
BBFILE_PATTERN_mylayer = "^${LAYERDIR}/"
BBFILE_PRIORITY_mylayer = "6"

LAYERDEPENDS_mylaer = "core"
LAYERSERIES_COMPAT_mylayer = "scarthgap"
```
